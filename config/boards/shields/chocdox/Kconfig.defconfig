## config/boards/shields/chocdox/Kconfig.defconfig
```kconfig
# Copyright (c) 2020 The ZMK Contributors
# SPDX-License-Identifier: MIT

if SHIELD_CHOCDOX_LEFT

config ZMK_KEYBOARD_NAME
	default "Chocdox Left"

config ZMK_SPLIT_BLE_ROLE_CENTRAL
	default y

endif


if SHIELD_CHOCDOX_RIGHT

config ZMK_KEYBOARD_NAME
	default "Chocdox Right"

endif

if SHIELD_CHOCDOX_LEFT || SHIELD_CHOCDOX_RIGHT

config ZMK_SPLIT
	default y
	
endif
```

## config/boards/shields/chocdox/Kconfig.shield
```kconfig
# Copyright (c) 2020 The ZMK Contributors
# SPDX-License-Identifier: MIT

config SHIELD_CHOCODOX_LEFT
	def_bool $(shields_list_contains,chocdox_left)

config SHIELD_CHOCDOX_RIGHT
	def_bool $(shields_list_contains,chocdox_right)
```
